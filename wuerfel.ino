#include <U8g2lib.h>
#include <SPI.h>
#include <SD.h>

#define LEDR 5
#define LEDG 7
#define KEY_RIGHT 2
#define KEY_DOWN 3
#define KEY_LEFT 4
#define KEY_UP 1
#define KEY_CENTER 0

U8G2_SH1106_128X64_NONAME_F_4W_HW_SPI u8g2(U8G2_R0, 10, 8, 9);

#define dsa_logo_width 128
#define dsa_logo_height 64
static unsigned char dsa_logo_bits[] = {
  0x00, 0x00, 0x00, 0x00, 0x00, 0x00, 0x00, 0x00, 0x00, 0x00, 0x00, 0x00, 
  0x00, 0x00, 0x00, 0x00, 0x00, 0x00, 0x00, 0x00, 0x00, 0x00, 0x00, 0x00, 
  0x00, 0x00, 0x00, 0x00, 0x00, 0x00, 0x00, 0x00, 0x00, 0x00, 0x00, 0x00, 
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  0x00, 0x00, 0x00, 0x00, };



int mode = 0;

int menu=0;
int eigenschaft1 = 10;
int eigenschaft2 = 10;
int eigenschaft3 = 10;
int fertigkeit = 0;
int modifikator = 0;
int rollen = 0;

void setup() {
  Serial.begin(9600);
  Serial.println("Programm gestartet");

  randomSeed(analogRead(0));
  pinMode(LEDG, OUTPUT);
  pinMode(LEDR, OUTPUT);
  pinMode(KEY_UP, INPUT_PULLUP);
  pinMode(KEY_DOWN, INPUT_PULLUP);
  pinMode(KEY_LEFT, INPUT_PULLUP);
  pinMode(KEY_RIGHT, INPUT_PULLUP);
  pinMode(KEY_CENTER, INPUT_PULLUP);
  liesHeldenbogen("test.fdf");
  u8g2.begin();
}

void liesHeldenbogen(String dateiname) {


}

void zeichneW6(int w6, int x, int y) {

  u8g2.drawLine(x,y+1,x,y+31);
  u8g2.drawLine(x+32,y+1,x+32,y+31);
  u8g2.drawLine(x+1,y,x+31,y);
  u8g2.drawLine(x+1,y+32,x+31,y+32);
  
  if(w6>1)
    u8g2.drawDisc(x+6,y+6,4);
  if( w6==6 )
    u8g2.drawDisc(x+6,y+16,4);
  if( w6>3 )
    u8g2.drawDisc(x+6,y+26,4);
  if( w6>3 )
    u8g2.drawDisc(x+26,y+6,4);
  if( w6==6 )
    u8g2.drawDisc(x+26,y+16,4);
  if( w6>1 )
    u8g2.drawDisc(x+26,y+26,4);
  if( w6==1 || w6==5 || w6==3)
    u8g2.drawDisc(x+16,y+16,4);
 
}

void zeichneW20(int w20, int x, int y) {
  u8g2.drawLine(x,y+11,x+20,y);
  u8g2.drawLine(x+39,y+11,x+20,y);
  u8g2.drawLine(x,y+11,x+20,y+8);
  u8g2.drawLine(x+39,y+11,x+20,y+8);
  u8g2.drawLine(x+20,y+8,x+7,y+30);
  u8g2.drawLine(x+20,y+8,x+32,y+30);
  u8g2.drawLine(x+20,y,x+20,y+8);
  u8g2.drawLine(x,y+11,x,y+33);
  u8g2.drawLine(x+39,y+11,x+39,y+33);
  u8g2.drawLine(x,y+33,x+7,y+30);
  u8g2.drawLine(x+39,y+33,x+32,y+30);
  u8g2.drawLine(x+7,y+30,x+32,y+30);
  u8g2.drawLine(x,y+11,x+7,y+30);
  u8g2.drawLine(x+39,y+11,x+32,y+30);
  u8g2.drawLine(x,y+33,x+20,y+45);
  u8g2.drawLine(x+39,y+33,x+20,y+45);
  u8g2.drawLine(x+7,y+30,x+20,y+45);
  u8g2.drawLine(x+32,y+30,x+20,y+45);
  u8g2.setFont(u8g2_font_t0_12_tf );
  char s[2];
  itoa(w20,s,10);
  u8g2.drawStr(x+14 + (w20<10 ? 3 : 0),y+27, s);
}

void loop() {
  if( mode==0 ) title();
  if( mode==1 ) werte();
  if( mode==2 ) wuerfeln();
}

long seed=0;
void title() {
  seed++;
  u8g2.clearBuffer();
  u8g2.drawXBM( 0, seed<=256?64-seed/4:0, dsa_logo_width, dsa_logo_height, dsa_logo_bits);
  u8g2.setFont(u8g2_font_6x12_me);
  u8g2.drawUTF8( (420-(seed%1300)), 60, "Ein Würfeltool für die 5. Edition von DAS SCHWARZE AUGE. Entwickelt von Kai Frerich im November 2023.                          Frohe Weihnachten!");
  u8g2.sendBuffer();
  delay(1);
  while (digitalRead(KEY_CENTER) == LOW) {
    mode=1;
    delay(1);
  }
}

void werte() {
  char s[3];
  u8g2.clearBuffer();
  u8g2.setFont(u8g2_font_6x12_me);
  u8g2.setFontMode(0);


  u8g2.setDrawColor(menu==4?0:1);
  u8g2.drawStr(0, 46, " Modifikator:          ");
  itoa(modifikator,s,10);
  u8g2.drawStr(105, 46, s);

  u8g2.setDrawColor(menu==3?0:1);
  u8g2.drawStr(0, 37, " Fertigkeitswert:      ");
  itoa(fertigkeit,s,10);
  u8g2.drawStr(105, 37, s);

  u8g2.setDrawColor(menu==2?0:1);
  u8g2.drawStr(0, 28, " Eigenschaft 3:        ");
  itoa(eigenschaft3,s,10);
  u8g2.drawStr(105, 28, s);

  u8g2.setDrawColor(menu==1?0:1);
  u8g2.drawStr(0, 19, " Eigenschaft 2:        ");
  itoa(eigenschaft2,s,10);
  u8g2.drawStr(105, 19, s);

  u8g2.setDrawColor(menu==0?0:1);
  u8g2.drawStr(0, 10, " Eigenschaft 1:        ");
  itoa(eigenschaft1,s,10);
  u8g2.drawStr(105, 10, s);

  u8g2.setDrawColor(menu==5?0:1);
  u8g2.drawUTF8(0, 62, "  Probe durchführen  ");
  
  u8g2.setFontMode(1);
  u8g2.setDrawColor(1);
  u8g2.sendBuffer();
  delay(10);
  seed++;

  if (digitalRead(KEY_DOWN) == LOW) {
    menu=(menu+1)%6;
    delay(300);
  } else if (digitalRead(KEY_UP) == LOW) {
    menu=(menu+5)%6;
    delay(300);
  } else if (digitalRead(KEY_RIGHT) == LOW && menu==0 && eigenschaft1<21) {
    eigenschaft1++;
    delay(150);
  } else if (digitalRead(KEY_RIGHT) == LOW && menu==1 && eigenschaft2<21) {
    eigenschaft2++;
    delay(150);
  } else if (digitalRead(KEY_RIGHT) == LOW && menu==2 && eigenschaft3<21) {
    eigenschaft3++;
    delay(150);
  } else if (digitalRead(KEY_RIGHT) == LOW && menu==3 && fertigkeit<21) {
    fertigkeit++;
    delay(150);
  } else if (digitalRead(KEY_RIGHT) == LOW && menu==4 && modifikator<10) {
    modifikator++;
    delay(150);
  } else if (digitalRead(KEY_LEFT) == LOW && menu==0 && eigenschaft1>7) {
    eigenschaft1--;
    delay(150);
  } else if (digitalRead(KEY_LEFT) == LOW && menu==1 && eigenschaft2>7) {
    eigenschaft2--;
    delay(150);
  } else if (digitalRead(KEY_LEFT) == LOW && menu==2 && eigenschaft3>7) {
    eigenschaft3--;
    delay(150);
  } else if (digitalRead(KEY_LEFT) == LOW && menu==3 && fertigkeit>0) {
    fertigkeit--;
    delay(150);
  } else if (digitalRead(KEY_LEFT) == LOW && menu==4 && modifikator>-10) {
    modifikator--;
    delay(150);
  }
  while (digitalRead(KEY_CENTER) == LOW) {
    if( menu==5 ) {
      mode=2;
      randomSeed(seed);
      rollen=0;
    }
    delay(1);
  }
}

void wuerfeln() {
  if( rollen<2000 ) {
    u8g2.clearBuffer();
    //zeichneW6(random(6)+1,5,0);

    int w1 = random(20)+1;
    int w2 = random(20)+1;
    int w3 = random(20)+1;

    zeichneW20(w1,0,0);
    zeichneW20(w2,44,0);
    zeichneW20(w3,88,0);

    int rest = fertigkeit;
    if( eigenschaft1+modifikator<w1 )
      rest -= w1-eigenschaft1-modifikator;
    if( eigenschaft2+modifikator<w2 )
      rest -= w2-eigenschaft2-modifikator;
    if( eigenschaft3+modifikator<w3 )
      rest -= w3-eigenschaft3-modifikator;

    if( rollen>=1000 ) {
      u8g2.setFont(u8g2_font_helvB08_te  );
      char s[30]; 
      if( rest<0 ) {
        strcpy(s,"Probe misslungen");
        digitalWrite(LEDR, HIGH);
        digitalWrite(LEDG, LOW);
      } else {
        sprintf(s,"Probe gelungen (QS%d)", max(1,min(6,(rest+2)/3)) );
        digitalWrite(LEDR, LOW);
        digitalWrite(LEDG, HIGH);
      }
      int w = u8g2.getStrWidth(s);
      u8g2.drawStr(64-w/2,60, s);
    }

    u8g2.sendBuffer();   
    delay(rollen);
    rollen+=rollen;
  }

  while (digitalRead(KEY_CENTER) == LOW) {
    if( rollen>=2000 ) {
      mode=1;
      seed=0;
      digitalWrite(LEDR, LOW);
      digitalWrite(LEDG, LOW);
      delay(10);
    } else if( rollen==0 ) {
      rollen=1;
    }
  }
}